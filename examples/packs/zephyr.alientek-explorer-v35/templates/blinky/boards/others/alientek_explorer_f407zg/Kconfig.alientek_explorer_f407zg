## examples/packs/zephyr.alientek-explorer-v35/templates/blinky/boards/others/alientek_explorer_f407zg/Kconfig.alientek_explorer_f407zg
```kconfig
# Copyright (c) 2020 Intel Corporation
# SPDX-License-Identifier: Apache-2.0

config BOARD_ALIENTEK_EXPLORER_F407ZG
	select SOC_STM32F407XG
```

## examples/packs/zephyr.alientek-explorer-v35/templates/blinky/boards/others/alientek_explorer_f407zg/board.yml
```yaml
# SPDX-License-Identifier: Apache-2.0

board:
  name: alientek_explorer_f407zg
  full_name: Alientek Explorer STM32F407ZG V3.5 (Experimental)
  vendor: others
  socs:
    - name: stm32f407xx
```
